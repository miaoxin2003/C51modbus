//FIRMWARE FOR SLAVE
#include <reg52.h>
#include <intrins.h>

typedef unsigned char  U8;       /* defined for unsigned 8-bits integer variable 	  无符号8位整型变量  */
typedef signed   char  S8;       /* defined for signed 8-bits integer variable		  有符号8位整型变量  */
typedef unsigned int   U16;      /* defined for unsigned 16-bits integer variable 	  无符号16位整型变量 */
typedef signed   int   S16;      /* defined for signed 16-bits integer variable 	  有符号16位整型变量 */
typedef unsigned long  U32;      /* defined for unsigned 32-bits integer variable 	  无符号32位整型变量 */
typedef signed   long  S32;      /* defined for signed 32-bits integer variable 	  有符号32位整型变量 */
typedef float          F32;      /* single precision floating point variable (32bits) 单精度浮点数（32位长度） */
typedef double         F64;      /* double precision floating point variable (64bits) 双精度浮点数（64位长度） */
//
#define uchar unsigned char
#define uint unsigned int
#define   Data_0_time    4

#define Uint16 unsigned int
#define Uint32 unsigned long
#define uchar  unsigned char

sbit nodesel0=P3^2;
sbit nodesel1=P3^3;
sbit reving=P1^6;
sbit rw=P3^4;

sbit DHT11=P1^0;//ds18b20与单片机连接口

U8  U8FLAG,k;
U8  U8count,U8temp;
U8  U8T_data_H,U8T_data_L,U8RH_data_H,U8RH_data_L,U8checkdata;
U8  U8T_data_H_temp,U8T_data_L_temp,U8RH_data_H_temp,U8RH_data_L_temp,U8checkdata_temp;
U8  U8comdata;

U8  count, count_r=0;



void InitUART(void);
void SendOneByte(unsigned);
void mdproc(uchar);
unsigned char ad0831read(void);	//定义该函数为读取ADC0831的数据
Uint16 Crc16(Uint16 *puchMsg, Uint16 usDataLen); 

uchar node;
uchar mtx[11],mrx[10];
uchar send101[9]={0x00,0x04,0x06,0x00,0x00,0x00,0x00,0x00,0x00};
uchar timercnt;


// modbus protocal defination below :
uchar byterev;
bit nodeok;
uchar revptr;
bit crcok;
uchar datalen;
bit procok;
Uint16 delaycnt;

/* CRC 高位字节值表 */ 
const Uint16 code auchCRCHi[] = { 
0x00, 0xC1, 0x81, 0x40, 0x01, 0xC0, 0x80, 0x41, 0x01, 0xC0, 
0x80, 0x41, 0x00, 0xC1, 0x81, 0x40, 0x01, 0xC0, 0x80, 0x41, 
0x00, 0xC1, 0x81, 0x40, 0x00, 0xC1, 0x81, 0x40, 0x01, 0xC0, 
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0x80, 0x41, 0x00, 0xC1, 0x81, 0x40 
} ; 

/* CRC低位字节值表*/ 
const Uint16 code auchCRCLo[] = { 
0x00, 0xC0, 0xC1, 0x01, 0xC3, 0x03, 0x02, 0xC2, 0xC6, 0x06, 
0x07, 0xC7, 0x05, 0xC5, 0xC4, 0x04, 0xCC, 0x0C, 0x0D, 0xCD, 
0x0F, 0xCF, 0xCE, 0x0E, 0x0A, 0xCA, 0xCB, 0x0B, 0xC9, 0x09, 
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0x43, 0x83, 0x41, 0x81, 0x80, 0x40 
} ;



void Delay(U16 j)	//延时子函数
{      U8 i;
	for(;j>0;j--)
	{
		for(i=0;i<27;i++);

	}
}
void  Delay_10us(void)//延时10us子函数
{
	U8 i;
   i--;
   i--;
   i--;
   i--;
   i--;
   i--;
}
	
void  COM(void)	//读取DHT11数据
{
     
	U8 i;
          
	for(i=0;i<8;i++)	   //循环8次
	{
		
		U8FLAG=2;	//标志位=2
		while((!DHT11)&&U8FLAG++);//等待DHT11为1
		Delay_10us();//延时10us
		Delay_10us();//延时10us
		Delay_10us();//延时10us
		U8temp=0;	//清除缓存
		if(DHT11)U8temp=1;//获取数据
		U8FLAG=2;
		while((DHT11)&&U8FLAG++);//等待DHT11为0
	   	//超时则跳出for循环		  
		if(U8FLAG==1)break;
	   	//判断数据位是0还是1	 
	   	   
		// 如果高电平高过预定0高电平值则数据位为 1 
	   	 
		U8comdata<<=1;	//数据左移一位
		U8comdata|=U8temp;       //保存数据 //0
	}//rof
	   
}

	//--------------------------------
	//-----湿度读取子程序 ------------
	//--------------------------------
	//----以下变量均为全局变量--------
	//----温度高8位== U8T_data_H------
	//----温度低8位== U8T_data_L------
	//----湿度高8位== U8RH_data_H-----
	//----湿度低8位== U8RH_data_L-----
	//----校验 8位 == U8checkdata-----
	//----调用相关子程序如下----------
	//---- Delay();, Delay_10us();,COM(); 
	//--------------------------------

void RH(void)
{
	  //主机拉低18ms 
	DHT11=0;
	Delay(180);
	DHT11=1;
	 //总线由上拉电阻拉高 主机延时20us
	Delay_10us();
	Delay_10us();
	Delay_10us();
	Delay_10us();
	 //主机设为输入 判断从机响应信号 
	DHT11=1;
	 //判断从机是否有低电平响应信号 如不响应则跳出，响应则向下运行	  
	if(!DHT11)		 //T !	  
	{
		U8FLAG=2;
	 //判断从机是否发出 80us 的低电平响应信号是否结束	 
		while((!DHT11)&&U8FLAG++);
	   U8FLAG=2;
	 //判断从机是否发出 80us 的高电平，如发出则进入数据接收状态
	   while((DHT11)&&U8FLAG++);
	 //数据接收状态		 
	   COM();
	   U8RH_data_H_temp=U8comdata;//读取温度值高位
	   COM();
	   U8RH_data_L_temp=U8comdata;//读取温度值低位
	   COM();
	   U8T_data_H_temp=U8comdata;//读取湿度值高位
	   COM();
	   U8T_data_L_temp=U8comdata;//读取湿度值低位
	   COM();
	   U8checkdata_temp=U8comdata;//获取校验值
	   DHT11=1;
	 //数据校验 
	 
	   U8temp=(U8T_data_H_temp+U8T_data_L_temp+U8RH_data_H_temp+U8RH_data_L_temp);//数据校验 
	   if(U8temp==U8checkdata_temp)//数据校验 
	   {
			U8RH_data_H=U8RH_data_H_temp;//保存湿度值
			U8RH_data_L=U8RH_data_L_temp;//保存湿度值
			U8T_data_H=U8T_data_H_temp;//保存温度值
			U8T_data_L=U8T_data_L_temp;//保存温度值
			U8checkdata=U8checkdata_temp;//保存校验值
	   }//fi
	}//fi
}


void main(void)
{
	unsigned char temp8,i1=0,i2=11;
	Uint16 temp16;
    int i;
	reving=1;
	crcok=0;
	nodeok=0;
	timercnt=0x00;
	datalen=0;
	for(i=0;i<10;i++){mrx[i]=0x00;}
	for(i=0;i<11;i++){mtx[i]=0x00;}

	node=!nodesel1;
	node<<=1;
	node|=!nodesel0;  //SLAVE node is determine by the jumper set
	send101[0]=node;  //reply the node nummer
		
	InitUART();
/*	for(i=0;i<8;i++)
	{	temp8=send101[i];
		SendOneByte(temp8);
	}*/  //test sending...
	procok=0; // preset the PROCCESS OK FLAG is 1,from the RX to PROCCESS OK the bit is 0.
	rw=0;  //accroding to the MAX485 IC, /RE=1 means transfering ,and /RE=0 means receiving ,after INIT ,default state is receiving for SLAVE
	while(1)
	{	
		if(crcok==1)  //plugin the time delay in the communication for monitoring easily in proteus
		{	reving=0;
			// i1++;
			//send101[3]=i1;//ad0831read();  //get the ADC data
			//send101[4]=i1;//ad0831read();  //get the ADC data
			i2++;
			if(i2>3)
			{
				//调用温湿度读取子程序 
				i2=0;
				TR1 = 0;//Delay(1800);
				RH();Delay(180);RH();
				//U8RH_data_H=i2;U8T_data_H=i2+20;
				TR1 = 1;//Delay(1800);
			}
			send101[3]=U8RH_data_H;
			send101[4]=U8T_data_H;
			for(i=0;i<9;i++){mtx[i]=send101[i];}
			temp16=Crc16(send101,9);
			mtx[9]=(temp16>>8)&0x00ff;
			mtx[10]=temp16&0x00ff;

			delaycnt=0x3fff;
			while(delaycnt--){}
			rw=1;
			delaycnt=0x3ff;
			while(delaycnt--){}
			for(i=0;i<11;i++)
			{	temp8=mtx[i];
				SendOneByte(temp8);
			}
			crcok=0;
			delaycnt=0x3ff;
			while(delaycnt--){}
			rw=0;
			reving=1; // blink the led when received a currect frame and replied
		}			
	}
}


Uint16 Crc16(uchar *puchMsg, Uint16 usDataLen) 
{ 
	Uint16 uchCRCHi = 0xFF ;              /* 高CRC字节初始化  */ 
	Uint16 uchCRCLo = 0xFF ;              /* 低CRC 字节初始化 */ 
	Uint16 temp16;
	Uint32 uIndex ;                      /* CRC循环中的索引  */ 
	while (usDataLen--)                  /* 传输消息缓冲区   */ 
	{ 
		temp16=*puchMsg++;
		uIndex = uchCRCHi ^ temp16 ; /* 计算CRC          */ 
		uchCRCHi = uchCRCLo ^ auchCRCHi[uIndex] ; 
		uchCRCLo = auchCRCLo[uIndex] ; 
	} 
	return (uchCRCHi << 8 | uchCRCLo) ; 
}


void Timer0Interrupt(void) interrupt 1
{
    //TH0 = 0x3C;
    //TL0 = 0x0B0;
	if(++timercnt==50)
	{//	procok=1;
		timercnt=0;
	}

}

void UARTInterrupt(void) interrupt 4
{
    if(RI)
    {
        RI = 0;
        byterev=SBUF;
		mdproc(byterev);
    }
    else
        TI = 0;
}

void mdproc(uchar b)  //the simply MODBUS 04 command processing ,if node is right , then receive the whole frame and cheak the CRC , if CRC is OK ,then reply data to the HOST
{	Uint16 temp16_1,temp16_2;
	if(nodeok==0)
	{	if(b==node)
		{	nodeok=1;
			datalen=7;
			mrx[0]=b;
			revptr=1;
		}
	}
	else
	{	mrx[revptr++]=b;
		if(revptr==8)
		{	nodeok=0;
			temp16_1=Crc16(mrx,6);
			temp16_2=mrx[6];
			temp16_2<<=8;
			temp16_2|=mrx[7];
			if(temp16_1==temp16_2)
			{	crcok=1;
			//	reving=~reving;  
			}
						
		}
	}
}

void SendOneByte(unsigned char c)
{
    SBUF = c;
    while(!TI);
    TI = 0;
}


void InitUART(void)
{
    TMOD = 0x20;
    SCON = 0x50;
    TH1 = 0xFE;
    TL1 = TH1;
    PCON = 0x00;
    EA = 1;
    ES = 1;
    TR1 = 1;
	
	//TMOD |= 0x01;
    //TH0 = 0x3C;
    //TL0 = 0x0B0;  // timer sets at 20ms
   // ET0 = 1;
    //TR0 = 1;


}


void delay(void)								//空5个指令
{
	_nop_();_nop_();_nop_();_nop_();_nop_();

}
